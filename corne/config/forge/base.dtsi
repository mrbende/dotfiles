// ZMK Core Includes
#include <behaviors.dtsi>
// #include <behaviors/num_word.dtsi> // requires https://github.com/urob/zmk-auto-layer module
#include <dt-bindings/zmk/keys.h>
#include <dt-bindings/zmk/bt.h>
#include <dt-bindings/zmk/outputs.h>

// Layers
#define L0 0  // Base/QWERTY
#define SY 1  // Symbols/Numbers
#define FN 2  // Function/Window Management  
#define ED 3  // Code Editor
#define MA 4  // Macros/System

// Meh key
#define MEH LS(LC(LALT))
// Hyper key (Ctrl+Shift+Alt+Cmd)
#define HYPR LS(LC(LA(LGUI)))

// Custom keycodes for tmux
#define TMUX_PRE LC(A)    // Ctrl+A (tmux prefix)

// Custom keycodes for yabai
#define YABAI_LFT LA(H)    // Focus window left
#define YABAI_RGT LA(L)    // Focus window right
#define YABAI_UP LA(K)     // Focus window up
#define YABAI_DWN LA(J)    // Focus window down
#define YABAI_SPC1 LS(LA(N1))  // Space 1 (terminal)
#define YABAI_SPC2 LS(LA(N2))  // Space 2 (browser-work)
#define YABAI_SPC3 LS(LA(N3))  // Space 3 (slack)

// Vim keycodes (standardized definitions)
#define VIM_ZZ LS(Z)        // Vim ZZ (save and quit)
#define VIM_VS LS(V)        // Vim visual selection

// Behaviors Constants
#define TAPPING_TERM_MS 280
#define QUICK_TAP_MS 175
#define REQUIRE_PRIOR_IDLE_MS 150

// Key positions per hand
#define KEYS_L 0 1 2 3 4 5 12 13 14 15 16 17 24 25 26 27 28 29
#define KEYS_R 6 7 8 9 10 11 18 19 20 21 22 23 30 31 32 33 34 35
#define THUMBS 36 37 38 39 40 41

#include "behaviors.dtsi"
#include "macros.dtsi"

// Alpha layer: uncomment desired, comment the others
// #include "L1_colemak-dh.dtsi"
// #include "L1_colemak.dtsi"
// #include "L1_dvorak.dtsi"
#include "L0_qwerty.dtsi"

// Other layers
#include "L1_symbols.dtsi"
#include "L2_function.dtsi"
#include "L3_editor.dtsi"
#include "L4_system.dtsi"
